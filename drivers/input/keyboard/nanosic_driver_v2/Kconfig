## drivers/input/keyboard/nanosic_driver_v2/Kconfig
```kconfig
config KEYBOARD_NANO_8030_V2
	tristate "Nanosic 8030 Keyboard for M82"
	depends on ARCH_KONA && I2C && GPIOLIB && HID
	help
	  Say Y here if you have Nanosic 8030 I2C Keyboard.

	  If unsure, say N.

	  To compile this driver as a module, choose M here: the
```

## drivers/input/touchscreen/nt36532/Kconfig
```kconfig
#
# Novatek NT36xxx touchscreen driver configuration
#
config TOUCHSCREEN_NT36532_HOSTDL_SPI
	bool "Novatek NT36532 host download SPI driver"
	depends on SPI && INPUT_TOUCHSCREEN && FW_LOADER
	depends on TOUCHSCREEN_XIAOMI_TOUCHFEATURE && TOUCHSCREEN_NEW_PEN_CONNECT_STRATEGY
	help
	  Say Y here if you have a Novatek NT36532 no flash touchscreen connected
	  to your system by SPI bus.

	  If unsure, say N.

config TOUCHSCREEN_SUPPORT_NEW_GAME_MODE
	bool "Touch support for the new game mode interface"
	depends on TOUCHSCREEN_NT36532_HOSTDL_SPI
	default n
	help
	  Enable the Xiaomi touch-feature controls used by the NT36532 driver.

config TOUCHSCREEN_NVT_DEBUG_FS
	bool "Novatek NT36532 debugfs interface"
	depends on TOUCHSCREEN_NT36532_HOSTDL_SPI
	default n
	help
	  Enable the Novatek touchscreen diagnostic debugfs files.
```

## drivers/power/supply/maxim_pipa/Kconfig
```kconfig
# SPDX-License-Identifier: GPL-2.0-only

config ONEWIRE_GPIO_PIPA
	bool "Xiaomi Pipa GPIO one-wire controller"
	depends on GPIOLIB && OF
	help
	  Enable the Xiaomi Pipa GPIO based one-wire controllers used by the
	  battery authentication chips.

config BATT_VERIFY_BY_DS28E16_PIPA
	bool "Xiaomi Pipa DS28E16 battery authentication"
	depends on ONEWIRE_GPIO_PIPA && POWER_SUPPLY
	help
	  Enable DS28E16 authentication for the Pipa battery packs connected to
	  the master and slave GPIO one-wire controllers.
```

## drivers/power/supply/ti/Kconfig
```kconfig
# SPDX-License-Identifier: GPL-2.0
config BQ2597X_CHARGE_PUMP_PIPA
	tristate "Pipa BQ2597X direct charging"
	depends on I2C && QCOM_POWER_SUPPLY && QPNP_SMB5_PIPA
	depends on USB_PD_POLICY && QPNP_USB_PDPHY
	help
	  Enable the Pipa BQ2597X direct-charge pump, USB PD policy manager,
	  and QC3.0 charging policy.

config DUAL_BQ2597X
	bool "Dual BQ2597X charge pumps"
	depends on BQ2597X_CHARGE_PUMP_PIPA
	help
	  Enable support for a master and slave BQ2597X charge-pump pair.
```

## techpack/datarmnet/core/Kconfig
```kconfig
#
# RMNET MAP driver
#

config RMNET_CORE
	tristate "RMNET MAP core"
	depends on NET && !RMNET
	default n
	select GRO_CELLS
	---help---
	  If you select this, you will enable the RMNET module which is used
	  for handling data in the multiplexing and aggregation protocol (MAP)
	  format in the embedded data path. RMNET devices can be attached to
	  any IP mode physical device.


config RMNET_CTL
	tristate "RMNET control MHI client"
	depends on MHI_BUS
	default n
	---help---
	  Enable the RMNET CTL module which is used for handling QMAP commands
	  for flow control purposes.
```
